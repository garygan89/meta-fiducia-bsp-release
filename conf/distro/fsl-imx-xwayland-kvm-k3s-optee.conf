## conf/distro/fsl-imx-xwayland-kvm-k3s-optee.conf
```bitbake
# i.MX DISTRO for Wayland with X11
# kvm, k3s, optee

include conf/distro/include/fsl-imx-base.inc
include conf/distro/include/fsl-imx-preferred-env.inc

DISTRO = "fsl-imx-xwayland-kvm-k3s"
DISTRO_NAME = "NXP i.MX Release Distro based with added kvm, k3s, optee support"

MAINTAINER = "FiduciaTek <GG>"

# Remove conflicting backends
DISTRO_FEATURES_remove = "directfb "
DISTRO_FEATURES_append = " x11 wayland pam"

# Use systemd
DISTRO_FEATURES_append = " systemd"
DISTRO_FEATURES_remove = "sysvinit"
VIRTUAL-RUNTIME_init_manager = "systemd"

# DISTRO_FEATURES supported by meta-virtualization
DISTRO_FEATURES_append = " optee virtualization kvm systemd aufs aufs-util cgroup-lite"

# Custom added DISTRO, these might/are not used by official OE recipe since we custom define them. Only useful if we write our own recipe.
DISTRO_FEATURES_append = " k3s"
```

## conf/layer.conf
```bitbake
# We have a conf and classes directory, add to BBPATH
BBPATH .= ":${LAYERDIR}"

# We have recipes-* directories, add to BBFILES
BBFILES += "${LAYERDIR}/recipes-*/*/*.bb \
            ${LAYERDIR}/recipes-*/*/*.bbappend"

BBFILE_COLLECTIONS += "meta-fiducia-bsp-release"
BBFILE_PATTERN_meta-fiducia-bsp-release = "^${LAYERDIR}/"
BBFILE_PRIORITY_meta-fiducia-bsp-release = "6"

LAYERSERIES_COMPAT_meta-fiducia-bsp-release = "sumo"
```
